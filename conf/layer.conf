## conf/layer.conf
```bitbake
# We have a conf and classes directory, add to BBPATH
BBPATH .= ":${LAYERDIR}"

# We have a packages directory, add to BBFILES
BBFILES += "${LAYERDIR}/recipes-*/*/*.bb \
            ${LAYERDIR}/recipes-*/*/*.bbappend"

BBFILE_COLLECTIONS += "adlink-demo"

BBFILE_PATTERN_adlink-demo := "^${LAYERDIR}"
BBFILE_PRIORITY_adlink-demo = "10"
LAYERVERSION_adlink-demo = "4"
LAYERSERIES_COMPAT_adlink-demo = "kirkstone mickledore scarthgap"

BBFILES_DYNAMIC += " \
    desktop-distro:${LAYERDIR}/dynamic-layers/meta-nxp-desktop/*/*/*.bb \
    desktop-distro:${LAYERDIR}/dynamic-layers/meta-nxp-desktop/*/*/*.bbappend \
    intel:${LAYERDIR}/dynamic-layers/meta-intel/*/*/*.bb \
    intel:${LAYERDIR}/dynamic-layers/meta-intel/*/*/*.bbappend \
    imx-demo:${LAYERDIR}/dynamic-layers/meta-nxp-demo-experience/*/*/*.bb \
    imx-demo:${LAYERDIR}/dynamic-layers/meta-nxp-demo-experience/*/*/*.bbappend \
    meta-real-time-edge:${LAYERDIR}/dynamic-layers/meta-real-time-edge/*/*/*.bb \
    meta-real-time-edge:${LAYERDIR}/dynamic-layers/meta-real-time-edge/*/*/*.bbappend \
    qt6-layer:${LAYERDIR}/dynamic-layers/meta-qt6/*/*/*.bb \
    qt6-layer:${LAYERDIR}/dynamic-layers/meta-qt6/*/*/*.bbappend \
    webserver:${LAYERDIR}/dynamic-layers/meta-webserver/*/*/*.bb \
    webserver:${LAYERDIR}/dynamic-layers/meta-webserver/*/*/*.bbappend \
    chromium-browser-layer:${LAYERDIR}/dynamic-layers/meta-chromium/*/*/*.bb \
    chromium-browser-layer:${LAYERDIR}/dynamic-layers/meta-chromium/*/*/*.bbappend \
    fsl-sdk-release:${LAYERDIR}/dynamic-layers/meta-imx-sdk/*/*/*.bb \
    fsl-sdk-release:${LAYERDIR}/dynamic-layers/meta-imx-sdk/*/*/*.bbappend \
    virtualization-layer:${LAYERDIR}/dynamic-layers/meta-virtualization/*/*/*.bb \
    virtualization-layer:${LAYERDIR}/dynamic-layers/meta-virtualization/*/*/*.bbappend \
"
```
